## conf/layer.conf
```bitbake
# We have a conf and classes directory, add to BBPATH
BBPATH .= ":${LAYERDIR}"

# We have a recipes-* directories, add to BBFILES
BBFILES += "${LAYERDIR}/recipes-*/*/*.bb \
	${LAYERDIR}/recipes-*/*/*.bbappend"

BBFILE_COLLECTIONS += "dashsight-layer"
BBFILE_PATTERN_dashsight-layer = "^${LAYERDIR}/"
BBFILE_PRIORITY_dashsight-layer = "6"

LAYERSERIES_COMPAT_dashsight-layer = "zeus dunfell"
```
